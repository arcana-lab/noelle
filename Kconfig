## Kconfig
```kconfig
config NOELLE_INSTALL_DIR
  string "Installation directory for Noelle"
  default "./install"

config NOELLE_SVF
  bool "Use SVF analyses"
  default n

config NOELLE_SCAF
  bool "Use SCAF analyses"
  default n

config NOELLE_TOOLS
  bool "Install all the tools build on top of Noelle"
  default y

config NOELLE_AUTOTUNER
  bool "Install the Noelle Autotuner"
  default y

config NOELLE_REPL
  bool "Build the Noelle REPL tool"
  default n

config NOELLE_BUILD_TYPE
  string "Set build type for NOELLE"
  default "Debug"

config SVF_BUILD_TYPE
  string "Set build type for SVF"
  default "Release"

config SCAF_BUILD_TYPE
  string "Set build type for SCAF"
  default "Release"
```
